## Kconfig
```kconfig
config ZMK_INPUT_PROCESSOR_CONTINUOUS_TEMP_LAYER
    bool "Continuous temporary layer input processor"
    default y
```

## dts/bindings/zmk,input-processor-continuous-temp-layer.yaml
```yaml
description: |
  Input processor that activates a temporary ZMK layer after
  continuous relative input has been detected.

compatible: "zmk,input-processor-continuous-temp-layer"

include: base.yaml

input-processor-cells:
  - layer
  - timeout

properties:
  continuous-ms:
    type: int
    required: true
    description: |
      Time in milliseconds that relative input must continue
      before the temporary layer is activated.

  max-gap-ms:
    type: int
    default: 50
    description: |
      Maximum allowed gap between relative input events while
      the input is considered continuous.

  track-remainders:
    type: boolean
    description: |
      Allow the input listener to track remainders for this processor.
```
